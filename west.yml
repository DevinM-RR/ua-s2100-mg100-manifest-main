## west.yml
```yaml
manifest:
  remotes:
    - name: JsmnRepo
      url-base: https://github.com/zserge
    - name: DevinRR
      url-base: https://github.com/DevinM-RR

  # Please add items below based on alphabetical order.
  # These dependencies may need updating if new features are added to the firmware.
  projects:
    - name: ua-s2100-zephyr_framework
      path: modules/framework
      revision: d61fac8720793452491e8fb8ec1ff47483c4f952
      remote: DevinRR
    - name: jsmn
      path: modules/jsmn
      revision: 7b6858a5855299d173c5ab2b46e611bf9961cbef
      remote: JsmnRepo
    #- name: memfault-firmware-sdk
    #  path: modules/memfault-firmware-sdk
    #  revision: 0.16.1
    #  remote: DevinRR
    - name: ua-s2100-mg100-firmware-2038-main
      path: ble_gateway_firmware
      revision: Regal_Release_4.0.10
      remote: DevinRR
    - name: ua-s2100-sdk-nrf
      path: nrf
      revision: 6e7e7fa2ad39d02773533458ca0d7a8f93db377e
      remote: DevinRR
      import: true
    - name: ua-s2100-zephyr
      # path: zephyr
      west-commands: scripts/west-commands.yml
      revision: 47f9ecc1dd358885d94ba469dc5a944349c3034c
      remote: DevinRR
      import: true
    - name: ua-s2100-2038-zephyr-boards-main
      path: ble_gateway_firmware/boards/arm
      revision: Regal_Release_4.0.10
      remote: DevinRR
    - name: ua-s2100-2038-zephyr-lib-main
      path: modules/zephyr_lib      
      revision: Regal_Release_4.0.10
      remote: DevinRR

  self:
    path: ble_gateway_firmware_manifest
```
